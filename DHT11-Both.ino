#define BLINKER_WIFI
#define BLINKER_ALIGENIE_SENSOR   // tj - 定义为天猫精灵传感器设备
#include <Blinker.h>
#include <DHT.h>
#define tmin 30   //tj-设置温度阈值
#define hmin 50   //tj-设置湿度阈值
#include <U8g2lib.h>
#define rst  2
U8G2_SSD1306_128X64_NONAME_F_HW_I2C  u8g2(U8G2_R0 , rst);
//取模得到的数组
//width:55,height:64 
const unsigned char col[] U8X8_PROGMEM = { 0x00,0x00,0x00,0x00,0x00,0x00,0x00,0x00,0x00,0x00,0x00,0x00,0x00,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0x00,0x00 };
char auth[] = "9d365a7b921a";
char ssid[] = "sun";
char pswd[] = "84582796";
char i = 0 ;
BlinkerNumber HUMI("num-shidu");
BlinkerNumber TEMP("num-wendu");


#define DHTPIN 2
#define DHTTYPE DHT11   // DHT 11

DHT dht(DHTPIN, DHTTYPE);

uint32_t read_time = 0;

float humi_read, temp_read;

void dataRead(const String & data)
{
  BLINKER_LOG("Blinker readString: ", data);

  Blinker.vibrate();

  uint32_t BlinkerTime = millis();

  Blinker.print("millis", BlinkerTime);
}

void heartbeat()
{
  HUMI.print(humi_read);
  TEMP.print(temp_read);
}
  
void dataStorage()
{
    Blinker.dataStorage("num-wendu", temp_read);
    Blinker.dataStorage("num-shidu", humi_read);
}

void setup()
{
    u8g2.begin();
  Serial.begin(115200);
  BLINKER_DEBUG.stream(Serial);

  pinMode(LED_BUILTIN, OUTPUT);
  digitalWrite(LED_BUILTIN, LOW);
  Blinker.begin(auth, ssid, pswd);
  Blinker.attachData(dataRead);
  Blinker.attachHeartbeat(heartbeat);
  BlinkerAliGenie.attachQuery(aligenieQuery);
  Blinker.attachDataStorage(dataStorage);
  dht.begin();
}
void aligenieQuery(int32_t queryCode)
{
    switch (queryCode)
    {
        case BLINKER_CMD_QUERY_ALL_NUMBER :
            BLINKER_LOG("AliGenie Query All");
            BlinkerAliGenie.temp(temp_read);
            BlinkerAliGenie.humi(humi_read);
            BlinkerAliGenie.print();
            break;
        case BLINKER_CMD_QUERY_TEMP_NUMBER :
            BlinkerAliGenie.temp(temp_read);
            BlinkerAliGenie.print();
            break;
        case BLINKER_CMD_QUERY_HUMI_NUMBER :
            BlinkerAliGenie.humi(humi_read);
            BlinkerAliGenie.print();
            break;
        default :
            BlinkerAliGenie.temp(20);
            BlinkerAliGenie.humi(20);
            BlinkerAliGenie.print();
            break;
    }
}
void loop()
{
  if(i == 100) i=-100;
  
  Blinker.run();
  u8g2.clearBuffer();           // 清空显示设备内部缓冲区
  u8g2.drawXBMP( i , 0 , 95 , 66 , col );     //50,50为图片尺寸，根据你的图片尺寸修改
  i+=10;
  u8g2.sendBuffer();         // 显示缓冲区内容
  delay(1000);  
  if (read_time == 0 || (millis() - read_time) >= 2000)
  {
    read_time = millis();

    float h = dht.readHumidity();
    float t = dht.readTemperature();

    if (isnan(h) || isnan(t)) {
      BLINKER_LOG("Failed to read from DHT sensor!");
      return;
    }

    float hic = dht.computeHeatIndex(t, h, false);

    humi_read = h;
    temp_read = t;

    BLINKER_LOG("Humidity: ", h, " %");
    BLINKER_LOG("Temperature: ", t, " *C");
    BLINKER_LOG("Heat index: ", hic, " *C");

    String wd, sd, s1, s2, s3 , s4, wdsd ;
    s1 = t;
    s2 = " Warning!The tempreture is :";
    s3 = h;
    s4 = " Warning!The humidity is :";
    wd = s2 + s1;
    sd = s4 + s3;
    wdsd = s2 + s1 + s4 + s3 ;
    if (t >= tmin && h >= hmin) Blinker.wechat(wdsd) ;  //tj-情况一：温度、湿度均高于阈值
    else if (h >= hmin) Blinker.wechat(sd) ;            //tj-情况二：仅湿度高于阈值
    else if (t >= tmin) Blinker.wechat(wd);         //tj-情况三：仅温度高于阈值
  }
}
